## yocto/build/conf/bblayers.conf
```bitbake
# POKY_BBLAYERS_CONF_VERSION is increased each time build/conf/bblayers.conf
# changes incompatibly
POKY_BBLAYERS_CONF_VERSION = "2"

BBPATH = "${TOPDIR}"
BBFILES ?= ""

BBLAYERS ?= " \
  /home/rayane/Documents/yocto_mrt/yocto/sources/poky/meta \
  /home/rayane/Documents/yocto_mrt/yocto/sources/poky/meta-poky \
  /home/rayane/Documents/yocto_mrt/yocto/sources/meta-raspberrypi \
  /home/rayane/Documents/yocto_mrt/yocto/sources/meta-openembedded/meta-filesystems \
  /home/rayane/Documents/yocto_mrt/yocto/sources/meta-openembedded/meta-python \
  /home/rayane/Documents/yocto_mrt/yocto/sources/meta-openembedded/meta-networking \
  /home/rayane/Documents/yocto_mrt/yocto/sources/meta-openembedded/meta-oe \
  /home/rayane/Documents/yocto_mrt/yocto/sources/meta-openembedded/meta-multimedia \
  /home/rayane/Documents/yocto_mrt/yocto/sources/meta-virtualization \ 
  "
```
